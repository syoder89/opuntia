## opuntia_imagestream/package/ipt-netflow/Config.in
```kconfig
# ipt-netflow advanced configuration

menu "Configuration"
	depends on PACKAGE_kmod-ipt-netflow

config IPT_NETFLOW_NATEVENTS
        bool "Enable support for netevents (NEL)"
        default y

config IPT_NETFLOW_SAMPLER
	bool "Enable flow sampler"
	default n

config IPT_NETFLOW_SNMP_AGENT
	bool "Enable support for the net-snmp agent module"
	default y

config IPT_NETFLOW_MACADDRESS
	bool "Enable exporting of src and dst MAC addresses for every flow. MAC addresses will be part of flow key."
	default n

config IPT_NETFLOW_VLAN
	bool "Enable exporting of dot1q VLAN IDs and Priorities for every flow"
	default n

config IPT_NETFLOW_DIRECTION
	bool "Enable exporting of flowDirection elements"
	default n

config IPT_NETFLOW_PHYSDEV
	bool "Export ingressPhysicalInterface and egressPhysicalInterface"
	default n

endmenu
```

## opuntia_imagestream/package/leds-apu2/src/Kconfig
```kconfig
config LEDS_APU2
        tristate "ImageStream APU2 / PoE Board LED support"
        depends on LEDS_CLASS
        depends on LEDS_GPIO
        depends on GPIOLIB
        help
          Say yes here to enable support for the CPU GPIO pins on the ImageStream
          AP2100 PoE board, which enables the LEDs.
```

## target/linux/ktt30/image/Config.in
```kconfig
config TARGET_KERNEL_PARTSIZE
        int "Kernel partition size (in MB)"
        default 64

config TARGET_ROOTFS_PARTNAME
        string "Root partition on target device"
	default "/dev/mmcblk1p2"
        help
          The root partition on the final device.  If you don't know,
          you probably want the default (/dev/mmcblk1p2).
```

## target/sdk/Config.in
```kconfig
config SDK
	bool "Build the Opuntia SDK"
	depends !EXTERNAL_TOOLCHAIN
	help
	  This is essentially a stripped-down version of the buildroot
	  with a precompiled toolchain. It can be used to develop and
	  test packages for Opuntia before including them in the buildroot
```

## target/toolchain/Config.in
```kconfig
config MAKE_TOOLCHAIN
	bool "Build the Opuntia based Toolchain"
	depends !EXTERNAL_TOOLCHAIN
	help
	  This is essentially the toolchain created by Opuntia.
```
